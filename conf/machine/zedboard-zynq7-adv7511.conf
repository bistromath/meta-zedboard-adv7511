## conf/machine/zedboard-zynq7-adv7511.conf
```bitbake
#@TYPE: Machine
#@NAME: zedboard-zynq7-adv7511
#@DESCRIPTION: Machine support for ZedBoard with ADV7511 HDMI IP

require conf/machine/include/tune-zynq.inc
require conf/machine/include/machine-xilinx-default.inc
require conf/machine/include/machine-xilinx-board.inc

# Zedboard machine definition known by Xilinx UBOOT
UBOOT_MACHINE = "zynq_zed_config"
SPL_BINARY = "boot.bin"

SERIAL_CONSOLE = "115200 ttyPS0"

# FIXME Use upstream bootloader
#PREFERRED_PROVIDER_virtual/bootloader = "u-boot"

# Kernel supporting Analog Devices and Xilinx IP
PREFERRED_PROVIDER_virtual/kernel = "linux-adi"

MACHINE_DEVICETREE := " \
		zedboard/zedboard-zynq7-board.dtsi   \
		zedboard/zedboard-zynq7-adv7511.dtsi \
		zedboard/zedboard-zynq7-adv7511.dts  \
		"

MACHINE_FEATURES = "keyboard usbhost"

# Zedboard does not have a RTC
MACHINE_FEATURES_BACKFILL_CONSIDERED = "rtc"

# FIXME Select individual modules
MACHINE_EXTRA_RRECOMMENDS += "kernel-modules"

IMAGE_BOOT_FILES += "boot.bin uEnv.txt ${MACHINE}.dtb"

EXTRA_IMAGEDEPENDS += "virtual/boot-bin"
```
